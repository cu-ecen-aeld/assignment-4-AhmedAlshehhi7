## base_external/Config.in
```kconfig
config BR2_PACKAGE_AESD_ASSIGNMENTS
    bool "aesd-assignments"
    help
      This package builds the AESD assignments application from your assignments-3-and-later repository.
```

## base_external/package/aesd-assignments/Config.in
```kconfig
config BR2_PACKAGE_AESD_ASSIGNMENTS
    bool "aesd-assignments"
    help
      This package builds the AESD Assignments finder application from the Assignment 3
      repository. It cross compiles the writer, finder.sh, finder-test.sh, and copies the
      conf directory into the target root filesystem.
```
